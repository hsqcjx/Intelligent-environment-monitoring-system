#include "adc.h"
/*
函数功能: ADC1的初始化
规则通道方式
*/
void ADC1_Init(void)
{
	  /*1. 开启时钟*/
		RCC->APB2ENR|=1<<3; //PB
		
	  RCC->APB2ENR|=1<<9;     //ADC1时钟
		RCC->APB2RSTR|=1<<9;    //开启复位时钟
	  RCC->APB2RSTR&=~(1<<9); //关闭复位时钟
	
		/*2. 配置GPIO口的模式*/
		GPIOB->CRL&=0xFFFFFFF0; //配置为模拟输入
		
		/*3. 配置ADC外设的时钟*/
		RCC->CFGR&=~(0x3<<14); //清除原来的时钟配置
		RCC->CFGR|=0x2<<14;    //配置ADC频率为12MHZ
	  
	  /*4. 配置ADC的核心寄存器*/
		ADC1->CR1&=~(0xF<<16); //配置ADC工作模式为独立模式
		ADC1->CR2|=1<<23;      //开启内部温度传感器测量
		ADC1->CR2|=1<<20;      //开启外部事件转换功能
		ADC1->CR2|=0x7<<17;    //选中SWSTART事件
		ADC1->CR2&=~(1<<11);   //数据右对齐
		ADC1->CR2&=~(1<<1);    //单次转换
		
		ADC1->SMPR1|=0x7<<18;  //通道16、温度传感器的采样时间
		ADC1->SMPR2|=0x7<<24;  //通道8采样时间
		
		ADC1->SQR1&=~(0xF<<20); //配置规则通道序列长度为1
		
		/*5. 开启ADC并进行校准*/
		ADC1->CR2|=1<<0;           //开/关A/D转换器
		ADC1->CR2|=1<<3;           //复位校准寄存器
		while(ADC1->CR2&1<<3){}    //等待复位完成
		ADC1->CR2|=1<<2;       	   //开启校准
		while(ADC1->CR2&1<<2){}    //等待校准完成
}

/*
函数功能: 获取指定通道的ADC值
函数参数: u8 ch  通道号
*/
u16 ADC1_GetCHx(u8 ch)
{
		ADC1->SQR3&=0xFFFFFFE0;
		ADC1->SQR3|=ch;   //设置当前转换的通道号
		ADC1->CR2|=1<<22; //开启一次规则通道的转换
		while(!(ADC1->SR&1<<1)){} //等待规则通道转换完成
		return ADC1->DR; //得到规则通道的数据
}

/*
函数功能: ADC1的初始化
注入通道方式
*/
void ADC1_Init_2(void)
{
	  /*1. 开启时钟*/
		RCC->APB2ENR|=1<<3; //PB
		
	  RCC->APB2ENR|=1<<9;     //ADC1时钟
		RCC->APB2RSTR|=1<<9;    //开启复位时钟
	  RCC->APB2RSTR&=~(1<<9); //关闭复位时钟
	
		/*2. 配置GPIO口的模式*/
		GPIOB->CRL&=0xFFFFFFF0; //配置为模拟输入
		
		/*3. 配置ADC外设的时钟*/
		RCC->CFGR&=~(0x3<<14); //清除原来的时钟配置
		RCC->CFGR|=0x2<<14;    //配置ADC频率为12MHZ
	  
	  /*4. 配置ADC的核心寄存器*/
		ADC1->CR1&=~(0xF<<16); //配置ADC工作模式为独立模式
		ADC1->CR2|=1<<23;      //开启内部温度传感器测量
		ADC1->CR2|=1<<15;      //开启注入通道的外部事件转换功能
		ADC1->CR2|=0x7<<12;    //选中注入通道SWSTART事件
		ADC1->CR2&=~(1<<11);   //数据右对齐
		ADC1->CR2&=~(1<<1);    //单次转换
		
		ADC1->SMPR1|=0x7<<18;  //通道16、温度传感器的采样时间
		ADC1->SMPR2|=0x7<<24;  //通道8采样时间 (PB0)
		
		ADC1->JSQR&=~(0x3<<20); //配置注入通道序列长度为1
		
		/*5. 开启ADC并进行校准*/
		ADC1->CR2|=1<<0;           //开/关A/D转换器
		ADC1->CR2|=1<<3;           //复位校准寄存器
		while(ADC1->CR2&1<<3){}    //等待复位完成
		ADC1->CR2|=1<<2;       	   //开启校准
		while(ADC1->CR2&1<<2){}    //等待校准完成
}

/*
函数功能: 获取指定通道的ADC值
函数参数: u8 ch  通道号
*/
u16 ADC1_GetCHx_Data(u8 ch)
{
		ADC1->JSQR&=~(0x1F<<15); //清空注入通道序号
		ADC1->JSQR|=ch<<15;      //设置当前注入通道转换的通道号
		ADC1->CR2|=1<<21; 			  //开启一次注入通道的转换
		while(!(ADC1->SR&1<<2)){} //等待注入通道转换完成
		ADC1->SR=0; 		 		//清空状态位
		return ADC1->JDR1;  //得到注入通道的数据
}
